## board/compulab/cl-som-imx8/Kconfig
```kconfig
if TARGET_CL_SOM_IMX8

config SYS_BOARD
	default "cl-som-imx8"

config SYS_VENDOR
	default "compulab"

config SYS_CONFIG_NAME
	default "cl-som-imx8"

endif
```

## board/compulab/imx8/Kconfig
```kconfig
if TARGET_COMPULAB_IMX8

choice
    prompt "CompuLab iMX8 board select"

config TARGET_CL_SOM_IMX8
    bool "cl-som-imx8"

endchoice

config DEFAULT_DTB
    string "U-Boot Default Device Tree File"
    depends on TARGET_COMPULAB_IMX8
    default "sbc-imx8.dtb"

config SYS_BOARD
	default "cl-som-imx8"

config SYS_VENDOR
	default "compulab"

config SYS_CONFIG_NAME
	default "cl-som-imx8"

choice
	prompt "RAM Volume select"
	default RAM_2G
	help
	 This option configures 2G RAM only

config RAM_1G
	bool "RAM_1G"
	help
	 This option configures 1G RAM only

config RAM_2G
	bool "RAM_2G"
	help
	 This option configures 2G RAM only

config RAM_BOARD_CFG
	bool "RAM_BOARD_CFG"
	help
	 Read board configuration GPIO for RAM size

endchoice

endif
```
